## drivers/char/jzchar/Kconfig
```kconfig
#
# JzSOC char devices configuration
#

menu "JZSOC char device support"
	depends on SOC_JZ4740 || SOC_JZ4730 || SOC_JZ4750 || SOC_JZ4750D || SOC_JZ4760 || SOC_JZ4760B || SOC_JZ4770 || SOC_JZ4810

config JZCHAR
	tristate 'JzSOC char device support'
	depends on SOC_JZ4740 || SOC_JZ4730 || SOC_JZ4750 || SOC_JZ4750D || SOC_JZ4760 || SOC_JZ4760B || SOC_JZ4770 || SOC_JZ4810 

config JZ_SIMPLE_I2C
	tristate 'Ingenic Simple I2C Userspace Driver'
	depends on SOC_JZ4740 || SOC_JZ4730 || SOC_JZ4750 || SOC_JZ4750D 

config JZ_GPIO_PM_KEY
	tristate 'Ingenic GPIO PM Key Driver'
	depends on SOC_JZ4740 || SOC_JZ4730 || SOC_JZ4750 || SOC_JZ4750D 

config JZ_TPANEL_ATA2508
	tristate 'JzSOC MPEG4 TOUCH PANEL ATA2508 support'
	depends on JZCHAR && (SOC_JZ4740 || SOC_JZ4730 || SOC_JZ4750 || SOC_JZ4750D)

#config JZ_TPANEL
#	tristate 'JzSOC touchpanel driver support' 
#	depends on JZCHAR

#	select JZ_SADC if SOC_JZ4740
#	select JZ_TPANEL_AK4182 if SOC_JZ4730

choice
	prompt "Touch Panel ADC type"
	depends on JZ_TPANEL
	default JZ_SADC if SOC_JZ4740 || SOC_JZ4750 || SOC_JZ4750D || SOC_JZ4750L
	default JZ_TPANEL_AK4182 if SOC_JZ4730

config JZ_SADC
	bool 'Select the JZ47XX internal SADC'

config JZ_TPANEL_AK4182
	bool 'Select the AK4182 codec'

config JZ_TPANEL_UCB1400
	bool 'Select the UCB1400 codec'

config JZ_TPANEL_WM9712
	bool 'Select the WM9712 codec'

endchoice

config JZ_OW
	tristate 'JZ One-wire bus support' 
	depends on JZCHAR && (SOC_JZ4740 || SOC_JZ4730 || SOC_JZ4750 || SOC_JZ4750D)

config JZ_TCSM
	tristate 'JZ TCSM support' 
	depends on JZCHAR && (SOC_JZ4750 || SOC_JZ4750D || SOC_JZ4750L || SOC_JZ4760 || SOC_JZ4760B || SOC_JZ4770 || SOC_JZ4810)

config JZ4770_TCU
	tristate 'Ingenic JZ4770 TCU Driver'
	depends on JZCHAR && SOC_JZ4770

config JZ_TSSI_4760
	tristate 'JZ MPEG2-TS interface support for JZ4760 or JZ4760B' 
	depends on JZCHAR && (SOC_JZ4760 || SOC_JZ4760B)

config JZ_WIEGAND
	tristate 'Wiegand impl on Ingenic Soc'
	depends on JZSOC

endmenu
```

## drivers/gpu/vivante/Kconfig
```kconfig
#
# VIVANTE_GPU support
#

menuconfig VIVANTE_GPU
	tristate "Vivante GPU"
	depends on JZSOC
	help
	  VIVANTE_GPU

config VIVANTE_GPU_GC200
	tristate "Vivante GPU GC200"
	depends on VIVANTE_GPU && (SOC_JZ4760 || SOC_JZ4760B)
	help
	  VIVANTE_GPU_GC200

config VIVANTE_GPU_GC860
	tristate "Vivante GPU GC860"
	depends on VIVANTE_GPU && SOC_JZ4770
	help
	  VIVANTE_GPU_GC860

config LINUX_VIVANTE_GPU_GC860
	tristate "Linux Vivante GPU GC860"
	depends on VIVANTE_GPU && SOC_JZ4770
	default n
	help
	  LINUX_VIVANTE_GPU_GC860
```

## drivers/media/video/jz_cim/Kconfig
```kconfig
choice
	prompt "Select cim output format"
	depends on VIDEO_JZ_CIM && SOC_JZ4780
	default VIDEO_JZ_CIM_OUT_FMT_BYPASS

config VIDEO_JZ_CIM_OUT_FMT_BYPASS
	bool 'Bypass Mode'

#config VIDEO_JZ_CIM_OUT_FMT_YUV444
#	bool 'CSC to YUV444'

config VIDEO_JZ_CIM_OUT_FMT_YUV422
	bool 'CSC to YUV422'

config VIDEO_JZ_CIM_OUT_FMT_YUV420
	bool 'CSC to YUV420'

endchoice

choice
	prompt "Select cim input format(eg. sensor output format)"
	depends on VIDEO_JZ_CIM
	default VIDEO_JZ_CIM_IN_FMT_YUV422

config	VIDEO_JZ_CIM_IN_FMT_YUV444
	bool 'YUV444'

config	VIDEO_JZ_CIM_IN_FMT_YUV422
	bool 'YUV422'

config	VIDEO_JZ_CIM_IN_FMT_ITU656
	bool 'ITU656'

#config	VIDEO_JZ_CIM_IN_FMT_RGB565
#	bool 'RGB565'
#	depends on VIDEO_JZ_CIM_OUT_FMT_BYPASS

endchoice

choice
	prompt "Select camera sensor"
	depends on VIDEO_JZ_CIM
	default VIDEO_OV3640

config VIDEO_GC0303
	bool "GalaxyCore 0303 sensor support"
	depends on VIDEO_JZ_CIM

config VIDEO_GC0308
	bool "GalaxyCore 0308 sensor support"
	depends on VIDEO_JZ_CIM

config VIDEO_GC0307
	bool "GalaxyCore 0307 sensor support"
	depends on VIDEO_JZ_CIM

config VIDEO_BF3703
	bool "OmniVision VIDEO_BF3703 sensor support (0.3 MegaPixel)"
	depends on VIDEO_JZ_CIM
config VIDEO_OV3640
	bool "OmniVision VIDEO_OV3640 sensor support (3.1 MegaPixel)"
	depends on VIDEO_JZ_CIM
config VIDEO_OV2655
	bool "OmniVision VIDEO_OV2655 sensor support (2.0 MegaPixel)"
	depends on VIDEO_JZ_CIM
config VIDEO_CM3511
	bool "CM3511 sensor support (0.3 MegaPixel)"
	depends on VIDEO_JZ_CIM

config VIDEO_OV2640
	bool "OmniVision VIDEO_OV2640 sensor support (2.0 MegaPixel)"
	depends on VIDEO_JZ_CIM
config VIDEO_OV9650
	bool "OmniVision VIDEO_OV9650 sensor support (1.3 MegaPixel)"
	depends on VIDEO_JZ_CIM
config VIDEO_OV7690
	bool "OmniVision VIDEO_OV7690 sensor support (0.3 MegaPixel)"
	depends on VIDEO_JZ_CIM
config VIDEO_ISP
	bool "Corelogic isp with SamSung S5K sensor support (3.1 MegaPixel)"
	depends on VIDEO_JZ_CIM && JZ_I2C_SIMULATE
config VIDEO_JZ_FAKE_SENSOR
	bool "jz fake sensor support (3.1 MegaPixel)"
	depends on VIDEO_JZ_CIM
config VIDEO_JZ_TVP5150
	bool "TVP5150 video decorder"
	depends on VIDEO_JZ_CIM
endchoice

config VIDEO_JZ_CIM_VA
	bool 'Use Virtual Address'
	depends on VIDEO_JZ_CIM && SOC_JZ4780
	default n
	help
	Use Virtual Address instead of Physical Address for Jz4780 CIM.
	
config VIDEO_JZ_CIM_MB
	bool 'Use Macro Block'
	depends on VIDEO_JZ_CIM && VIDEO_JZ_CIM_OUT_FMT_YUV420 && SOC_JZ4780
	default n
	help
	Enable Macro Block Mode for CIM output format YCbCr420.

config VIDEO_JZ_CIM_FSC
	bool 'Enable Frame Size Check'
	depends on VIDEO_JZ_CIM && SOC_JZ4780
	default y

config VIDEO_JZ_CIM_ARIF
	bool 'Enable Auto Recovery for Incomplete Frame'
	depends on VIDEO_JZ_CIM && VIDEO_JZ_CIM_FSC && SOC_JZ4780
	default y
```
