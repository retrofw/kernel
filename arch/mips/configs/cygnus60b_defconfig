## drivers/power/jz47xx_battery/Kconfig
```kconfig
config BATTERY_JZ47XX
	bool "JZ47XX battery"
	select JZ_VOLTAGEM
	help
	  Say Y to enable support for the battery in JZ SOC.

if BATTERY_JZ47XX

choice
	prompt "Default interface"
	default BATTERY_JZ47XX_ACT8600
	help
	  This option sets which interface shall be loaded at
	  startup.
config BATTERY_JZ47XX_GPIO
	bool "interface base on gpio"
	help
	  interface base on gpio

config BATTERY_JZ47XX_ACT8600
	bool "interface base on act8600 pmu driver"
	depends on PMU_ACT8600_SUPPORT
	help
	  interface base on act8600 pmu driver

config BATTERY_JZ47XX_ACT8600V2
	bool "interface base on act8600 pmu driver v2"
	depends on PMU_ACT8600_SUPPORT
	help
	  interface base on act8600 pmu driver v2

config BATTERY_JZ47XX_FAKE
	bool "fake interface"
	help
	  fake interface for no battery system

endchoice

###############################################################################
choice
	prompt "charing mode select"
	default ACTBAT_NORMAL

config ACTBAT_NORMAL
	bool "use DC & USB for charing"
	depends on BATTERY_JZ47XX
	select ACTBAT_DC
	select ACTBAT_USB

config ACTBAT_ONLY_DC
	bool "only DC charging"
	depends on BATTERY_JZ47XX
	select ACTBAT_DC

config ACTBAT_ONLY_USB
	bool "only USB charging"
	depends on BATTERY_JZ47XX
	select ACTBAT_USB
endchoice


endif

config ACTBAT_DC
	bool
	default n
config ACTBAT_USB
	bool
	default n
```

## drivers/video/hdmi/Kconfig
```kconfig
choice
	depends on JZ4760_HDMI_DISPLAY 
	prompt  "HDMI Chip Select"
config HDMI_NULL
	bool "NULL"
endchoice
```

## drivers/video/lcd/Kconfig
```kconfig
#
# LCD panels configuration
#
choice
	depends on FB_JZ4760_LCD
	prompt "LCD Panel"
	default JZ4760_LCD_TM370_LN430_9
	---help---
	   Please select the lcd panel in you board

config JZ4760_LCD_TM370_LN430_9
	bool "RetroArcade TM370_LN430_9 TFT 480x272 18bit"

config JZ4760_LCD_RG_V10
	bool "RetroGame V1.0 AUO A030JTN01 320x480"

config JZ4760_LCD_RG_V21
	bool "RetroGame V2.1 INNOLUX EJ030NA-01B 320x480"

config JZ4760_LCD_RG_V30
	bool "RetroGame V3.0 LianKeWeiYe LKWY030A01 320x480"

config JZ4760_LCD_RG_IPS
	bool "RetroGame Sharp IPS"

config JZ4760_SLCD_SNK
	bool "RetroGame Plus SNK SLCD 320x240 16bit"
	select FB_JZ4760_SLCD

config LCD_NT39016
	bool "RetroGame 350 Novatek NT39016 320x240 24bit"

config JZ4760_LCD_SAMSUNG_LTP400WQF01
	bool "SAMSUNG LTP400WQF01 TFT 480x272 16bit"

config JZ4760_LCD_SAMSUNG_LTP400WQF02
	bool "SAMSUNG LTP400WQF02 TFT 480x272 18bit"

config JZ4760_LCD_AUO_A043FL01V2
	bool "AUO A043FL01V2 TFT 480x272 24bit"

config JZ4760_LCD_FOXCONN_PT035TN01
 	bool "FOXCONN PT035TN01 TFT 320x240 18bit-parallel"

config JZ4760_LCD_INNOLUX_PT035TN01_SERIAL
 	bool "INNOLUX PT035TN01 TFT 320x240 8bit-serial"

config JZ4760_LCD_TOPPOLY_TD025THEA7_RGB_DELTA
	bool "TOPPOLY_TD025THEA7 TFT 320x240 serial RGB delta mode"

config JZ4760_LCD_TOPPOLY_TD043MGEB1
	bool "TOPPOLY_TD043MGEB1 TFT 800x480 24bit"

config UMIDO_LCD_4_3
	bool "Umidotech TFT LCD 4.3 480x272 24bit"

config JZ4760_LCD_TRULY_TFTG320240DTSW_18BIT
	bool "TRULY_TFTG320240DTSW TFT 320x240 18bit-parallel"

config JZ4760_LCD_TRULY_TFT_GG1P0319LTSW_W
	bool "TRULY_TFT_GG1P0319LTSW_W 240x320 Smart LCD 16bit"

config JZ4760_SLCD_KGM701A3_TFT_SPFD5420A
	bool "KGM701A3_TFT_SPFD5420A 400x240 Smart LCD 18bit"
	select FB_JZ4750_SLCD

config JZ4760_LCD_HYNIX_HT12X14
	bool "HYNIX_HT12X14 (1024x768) (LVDS)"

config JZ4760_LCD_KD101N2
	bool "GUO XIAN KD101N2 (1024x600) (LVDS)"

config JZ4760_LCD_KD101N4
	bool "GUO XIAN KD101N4 (1280x800) (LVDS)"

config JZ4760_VGA_DISPLAY
	depends on (SOC_JZ4760 || SOC_JZ4760B || SOC_JZ4770)
	bool "Jz4760 VGA Display"

endchoice
```

## sound/soc/codecs/Kconfig
```kconfig
config SND_SOC_AC97_CODEC
	tristate
	depends on SND_SOC

config SND_SOC_WM8731
	tristate
	depends on SND_SOC

config SND_SOC_WM8750
	tristate
	depends on SND_SOC

config SND_SOC_WM8753
	tristate
	depends on SND_SOC

config SND_SOC_WM9712
	tristate
	depends on SND_SOC

# Cirrus Logic CS4270 Codec
config SND_SOC_CS4270
	tristate
	depends on SND_SOC

# Cirrus Logic CS4270 Codec Hardware Mute Support
# Select if you have external muting circuitry attached to your CS4270.
config SND_SOC_CS4270_HWMUTE
	bool
	depends on SND_SOC_CS4270

# Cirrus Logic CS4270 Codec VD = 3.3V Errata
# Select if you are affected by the errata where the part will not function
# if MCLK divide-by-1.5 is selected and VD is set to 3.3V.  The driver will
# not select any sample rates that require MCLK to be divided by 1.5.
config SND_SOC_CS4270_VD33_ERRATA
	bool
	depends on SND_SOC_CS4270

config SND_SOC_ICODEC
	tristate "Jz4740 internal codec"
	depends on SND_SOC && SND_JZ4740_SOC_PAVO && SND_JZ4740_SOC_I2S
	help
	  Say Y if you want to use internal codec on Ingenic Jz4740 PAVO board.

config SND_SOC_DLV
	tristate "Jz4750 internal codec"
	depends on SND_SOC && SND_JZ4750_SOC_APUS && SND_JZ4750_SOC_I2S
	help
	  Say Y if you want to use internal codec on Ingenic Jz4750 APUS board.

config SND_SOC_ICDC
	tristate "Jz4760 internal codec"
	depends on SND_SOC && SND_JZ4760_SOC_LEPUS && SND_JZ4760_SOC_I2S
	help
	  Say Y if you want to use internal codec on Ingenic Jz4760 LEPUS board.

config SND_SOC_JZ4760_ICDC
	tristate
	depends on SND_SOC

config SND_SOC_JZ4770_ICDC
	tristate
	depends on SND_SOC
```

## sound/soc/jz4740/Kconfig
```kconfig
config SND_JZ4740_SOC
	tristate "SoC Audio for Ingenic jz4740 chip"
	depends on (JZ4740_PAVO || JZ4725_DIPPER || JZ4720_VIRGO) && SND_SOC
	help
	  Say Y or M if you want to add support for codecs attached to
	  the Jz4740 AC97, I2S or SSP interface. You will also need
	  to select the audio interfaces to support below.

config SND_JZ4740_SOC_PAVO
	tristate "SoC Audio support for Ingenic Jz4740 PAVO board"
	depends on SND_JZ4740_SOC
	help
	  Say Y if you want to add support for SoC audio of internal codec on Ingenic Jz4740 PAVO board.

config SND_JZ4740_AC97
	tristate "select AC97 protocol and AC97 codec pcm core support"
	depends on SND_JZ4740_SOC && SND_JZ4740_SOC_PAVO
	select SND_AC97_CODEC
	help
	  Say Y if you want to add AC97 protocol support for pcm core.

config SND_JZ4740_SOC_AC97
	tristate "SoC Audio (AC97 protocol) for Ingenic jz4740 chip"
	depends on SND_JZ4740_SOC && SND_JZ4740_AC97 && SND_JZ4740_SOC_PAVO
	select AC97_BUS
	select SND_SOC_AC97_BUS
	help
	  Say Y if you want to use AC97 protocol and ac97 codec on Ingenic Jz4740 PAVO board.

config SND_JZ4740_SOC_I2S
	depends on SND_JZ4740_SOC && SND_JZ4740_SOC_PAVO
	tristate "SoC Audio (I2S protocol) for Ingenic jz4740 chip"
	help
	  Say Y if you want to use I2S protocol and I2S codec on Ingenic Jz4740 PAVO board.
```

## sound/soc/jz47xx/Kconfig
```kconfig
config SND_JZ47XX_SOC
	tristate "SoC Audio for Ingenic jz47XX chip"
	depends on JZSOC && SND_SOC
	help
	  Say Y or M if you want to add support for codecs attached to
	  the Jz47XX AC97, I2S controller. 

config SND_JZ47XX_SOC_I2S
        tristate

config SND_JZ4760_SOC_LEPUS_ICDC
	tristate "SoC I2S Audio support for JZ4760 Lepus reference board with internal codec"
	depends on SND_JZ47XX_SOC
	depends on (SOC_JZ4760 || SOC_JZ4760B)
	select SND_JZ47XX_SOC_I2S
	select SND_SOC_JZ4760_ICDC
	help
	  Say Y if you want to add audio support for JZ4760 Lepus reference board with internal codec.
	  
config SND_SOC_HIFI_ECDC
	tristate "SoC I2S Audio support for HIFI with external codec"
	depends on SND_JZ47XX_SOC
	depends on (SOC_JZ4760 || SOC_JZ4760B)
	select SND_JZ47XX_SOC_I2S
	select SND_SOC_MY_ECDC
	help
	  Say Y if you want to add audio support for JZ4760 Lepus reference board with internal codec.

config SND_JZ4770_SOC_PISCES_ICDC
	tristate "SoC I2S Audio support for JZ4770 Pisces reference board with internal codec"
	depends on SND_JZ47XX_SOC
	depends on SOC_JZ4770
	select SND_JZ47XX_SOC_I2S
	select SND_SOC_JZ4770_ICDC
	help
	  Say Y if you want to add audio support for JZ4770 Pisces reference board with internal codec.
```
